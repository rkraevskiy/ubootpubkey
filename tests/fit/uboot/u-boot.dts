/dts-v1/;
/ {
	model ="Keys";
	compatible ="vendor,board";
	signature {
		key-my_key {
			required ="conf";
			algo ="sha1,rsa4096";
			key-name-hint ="uboot_sign_key";
#include "u-boot-pubkey.dtsi"
		};
	};
};

